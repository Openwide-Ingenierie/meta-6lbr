## conf/layer.conf
```bitbake
# We have a conf and classes directory, append to BBPATH
BBPATH .= ":${LAYERDIR}"

# We have a recipes directory containing .bb and .bbappend files, add to BBFILES
BBFILES += "${LAYERDIR}/recipes*/*/*.bb \
            ${LAYERDIR}/recipes*/*/*.bbappend"

BBFILE_COLLECTIONS += "6lbr"
BBFILE_PATTERN_6lbr := "^${LAYERDIR}/"
BBFILE_PRIORITY_6lbr = "9"

LAYERDEPENDS_6lbr = "core openembedded-layer networking-layer"
```
